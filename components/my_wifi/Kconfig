## components/my_wifi/Kconfig
```kconfig
menu "Wi-Fi Configuration"

config WIFI_SSID_1
    string "SSID network 1"
    default "WLAN1"

config WIFI_PASS_1
    string "password  network 1"
    default ""

config WIFI_SSID_2
    string "SSID network 2"
    default "WLAN2"

config WIFI_PASS_2
    string "password  network 2"
    default ""

config WIFI_SSID_3
    string "SSID network 3"
    default "WLAN3"

config WIFI_PASS_3
    string "password  network 3"
    default ""

config WIFI_SWITCH_BUTTON_GPIO
    int "GPIO for network selection"
    default 0

endmenu
```

## main/Kconfig.projbuild
```kconfig
menu "WiFi configuration"

config ESP_WIFI_SSID
    string "WiFi SSID"
    default "YOUR_SSID"
    help
      WiFi SSID to connect to.

config ESP_WIFI_PASSWORD
    string "WiFi Password"
    default "YOUR_PASSWORD"
    help
      Password for the WiFi network.

endmenu
```
